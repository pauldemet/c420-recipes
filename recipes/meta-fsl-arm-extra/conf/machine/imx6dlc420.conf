## recipes/meta-fsl-arm-extra/conf/machine/imx6dlc420.conf
```bitbake
#@TYPE: Machine
#@NAME: WinSystems i.MX6DL SBC-C420
#@SOC: i.MX6DL
#@DESCRIPTION: Machine configuration for WinSystems i.MX6DL SBC-C420
#@MAINTAINER: Paul DeMetrotion <pdemetrotion@winsystems.com>

require conf/machine/include/imx-base.inc
require conf/machine/include/tune-cortexa9.inc

SOC_FAMILY = "mx6:mx6dl:mx6q"

KERNEL_DEVICETREE = "imx6dl-c420.dtb"

PREFERRED_PROVIDER_u-boot = "u-boot-c420"
PREFERRED_PROVIDER_virtual/kernel ?= "linux-c420"
PREFERRED_VERSION_linux-c420 ?= "3.14.28"

#UBOOT_MACHINE = "mx6dlc420_config"

UBOOT_CONFIG ??= "sd"
UBOOT_CONFIG[sd] = "mx6dlc420_config,sdcard"
UBOOT_CONFIG[spinor] = "mx6dlc420_spinor_config"
UBOOT_CONFIG[mfgtool] = "mx6dlc420_config"

SERIAL_CONSOLE = "115200 ttymxc2"

MACHINE_FEATURES += " alsa apm ext2 keyboard pci rtc screen serial usbgadget usbhost vfat"
```
